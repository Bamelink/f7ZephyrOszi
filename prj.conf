## CMakeLists.txt
```
cmake_minimum_required(VERSION 3.20.0)
find_package(Zephyr REQUIRED HINTS $ENV{ZEPHYR_BASE})
project(f7Oszi)

FILE(GLOB app_sources src/*.c)
target_sources(app PRIVATE ${app_sources})
```

## Kconfig
```
source "Kconfig.zephyr"
config APP_WITH_STM32_HAL
  default y
  bool
  select USE_STM32_HAL
  select USE_STM32_HAL_CORTEX
  select USE_STM32_HAL_GPIO
  select USE_STM32_HAL_GPIO_EX
  select USE_STM32_HAL_ADC
  select USE_STM32_HAL_ADC_EX
  select USE_STM32_HAL_TIM
  select USE_STM32_HAL_TIM_EX
  select USE_STM32_HAL_HRTIM
  select USE_STM32_HAL_LPTIM
  select USE_STM32_HAL_EXTI
  select USE_STM32_HAL_DMA
  select USE_STM32_HAL_DMA_EX
  select USE_STM32_HAL_DMA2D
  select USE_STM32_HAL_PWR
  select USE_HAS_STM32CUBE 
  select USE_HAS_STM32LIB 
  select USE_STM32_HAL_PWR_EX
  select USE_STM32_LL_ADC
  select USE_STM32_LL_DMA
  select USE_STM32_LL_DMA2D
  select USE_STM32_LL_EXTI
  select USE_STM32_LL_GPIO
  select USE_STM32_LL_LPTIM
  select USE_STM32_LL_PWR
  select USE_STM32_LL_RCC
  select USE_STM32_LL_TIM
```

## prj.conf
```kconfig
CONFIG_GPIO=y


#USB FS
CONFIG_USB_DEVICE_STACK=y
CONFIG_USB_DEVICE_PRODUCT="Zephyr USB console sample"
CONFIG_USB_DEVICE_PID=0x0004
CONFIG_USB_DEVICE_INITIALIZE_AT_BOOT=n

CONFIG_SERIAL=y
CONFIG_CONSOLE=y
CONFIG_UART_CONSOLE=y
CONFIG_UART_LINE_CTRL=y
```

## boards/stm32f746g_disco.overlay
```dts
/ {
	chosen {
		zephyr,console = &cdc_acm_uart0;
	};
};

zephyr_udc0: &usbotg_fs {
    status = "okay";
};

&zephyr_udc0 {
	cdc_acm_uart0: cdc_acm_uart0 {
		compatible = "zephyr,cdc-acm-uart";
	};
};
```

## src/main.c
```c
#include <zephyr/kernel.h>
#include <zephyr/sys/printk.h>
#include <zephyr/usb/usb_device.h>
#include <zephyr/usb/usbd.h>
#include <zephyr/drivers/uart.h>
#include <zephyr/drivers/gpio.h>
#include "adc.h"

#define SLEEP_TIME_MS  1000


BUILD_ASSERT(DT_NODE_HAS_COMPAT(DT_CHOSEN(zephyr_console), zephyr_cdc_acm_uart),
	     "Console device is not ACM CDC UART device");

int main(void)
{
	/* ENABLE USB FS AS CONSOLE FOR PRINTK */
	const struct device *const dev = DEVICE_DT_GET(DT_CHOSEN(zephyr_console));
	uint32_t dtr = 0;

	if (usb_enable(NULL)) {
		return 0;
	}

	/* Poll if the DTR flag was set */
	while (!dtr) {
		uart_line_ctrl_get(dev, UART_LINE_CTRL_DTR, &dtr);
		/* Give CPU resources to low priority threads. */
		k_sleep(K_MSEC(100));
	}
	printk("USB Initialized\n");

	int ret;

	ret = adc_init();
	if (ret != 0) {
		return -1;
	}
	printk("ADC init success\n");

	while (1) {
		HAL_ADC_Start_IT(&hadc1);
		k_msleep(SLEEP_TIME_MS);
		printk("Hi\n");
	}
	return 0;
}
```

## src/adc.c
```c
#include "adc.h"
#include <zephyr/irq.h>

ADC_HandleTypeDef hadc1;
uint16_t ad_res = 0;

static void my_adc_isr(ADC_HandleTypeDef *dev)
{
    ad_res = HAL_ADC_GetValue(dev);
    printk("Interrupt tirggered!, value = %d\n", ad_res);
}

uint8_t adc_init()
{
    ADC_ChannelConfTypeDef sConfig = {0};

    hadc1.Instance = ADC1;
    hadc1.Init.ClockPrescaler = ADC_CLOCK_SYNC_PCLK_DIV4;
    hadc1.Init.Resolution = ADC_RESOLUTION_8B;
    hadc1.Init.ScanConvMode = ADC_SCAN_DISABLE;
    hadc1.Init.ContinuousConvMode = DISABLE;
    hadc1.Init.DiscontinuousConvMode = DISABLE;
    hadc1.Init.ExternalTrigConvEdge = ADC_EXTERNALTRIGCONVEDGE_NONE;
    hadc1.Init.ExternalTrigConv = ADC_SOFTWARE_START;
    hadc1.Init.DataAlign = ADC_DATAALIGN_RIGHT;
    hadc1.Init.NbrOfConversion = 1;
    hadc1.Init.DMAContinuousRequests = DISABLE;
    hadc1.Init.EOCSelection = ADC_EOC_SINGLE_CONV;
    if (HAL_ADC_Init(&hadc1) != HAL_OK)
    {
        return -1;
    }

    sConfig.Channel = ADC_CHANNEL_0;
    sConfig.Rank = ADC_REGULAR_RANK_1;
    sConfig.SamplingTime = ADC_SAMPLETIME_15CYCLES;
    if (HAL_ADC_ConfigChannel(&hadc1, &sConfig) != HAL_OK)
    {
        return -1;
    }

    __HAL_RCC_ADC1_CLK_ENABLE();
    __HAL_RCC_GPIOA_CLK_ENABLE();

    GPIO_InitTypeDef GPIO_InitStruct = {0};
    GPIO_InitStruct.Pin = GPIO_PIN_0;
    GPIO_InitStruct.Mode = GPIO_MODE_ANALOG;
    GPIO_InitStruct.Pull = GPIO_NOPULL;
    HAL_GPIO_Init(GPIOA, &GPIO_InitStruct);

    IRQ_CONNECT(18, 0, my_adc_isr, &hadc1, 0);
	irq_enable(18);


    return 0;
}
```

## src/adc.h
```c
#ifndef ADC_H
#define ADC_H

#include <stm32f7xx_hal.h>

extern ADC_HandleTypeDef hadc1;

uint8_t adc_init();

#endif
```
